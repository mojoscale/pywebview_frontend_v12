## core/transpiler/runtime/starter_template_espidf/sdkconfig.defaults
```kconfig
CONFIG_ARDUINO_ENABLED=y
CONFIG_FREERTOS_HZ=1000
CONFIG_SPI_FLASH_ROM_DRIVER_PATCH=y
CONFIG_ARDUINO_RUN_CORE1=y
CONFIG_ARDUINO_LOOP_STACK_SIZE=16384
CONFIG_ESP32_DEFAULT_CPU_FREQ_160=y
CONFIG_PARTITION_TABLE_SINGLE_APP=y
CONFIG_PARTITION_TABLE_FILENAME="partitions.csv"
CONFIG_PARTITION_TABLE_OFFSET=0x8000
CONFIG_ESPTOOLPY_FLASHSIZE_4MB=y
(or 2MB if appropriate)
```
